/*******************************************************************************
  * @author  Vince Keiper AstrodyneTDI
  * @version V1.0.0
  * @date    24-June-2015
  * @brief   ICCP GUI Main dialog Screen   
  ******************************************************************************
  * @attention
  *
  * <h2><center>&copy; COPYRIGHT(c) 2015 AstrodyneTDI</center></h2>
  *
  *
  ******************************************************************************  
  */ 

/* Includes ------------------------------------------------------------------*/

#include "dialog.h"
#include "k_module.h"
#include "k_storage.h"
#include "iccpfuncs.h"
#include "cpu_utils.h"
#include "k_rtc.h" 
#include "k_modules_res.h"
#include "iccp_can_stm32f429.h"
#include "iccp_canfuncs.h"

/******  ICCP   *********/

#include "cmsis_os.h"
#include "DIALOG.h"
#include "stdio.h"
#include "string.h"
#include "../../iccpfiles/globals.h"


extern GUI_CONST_STORAGE GUI_BITMAP bmAtdi_logo_small_trans;
extern GUI_CONST_STORAGE GUI_BITMAP bmdefender_shield_trans;
extern char mSDDISK_Drive[];
extern FATFS mSDDISK_FatFs;   

#define XSCN 480  // x dimension screen
#define YSCN 245  // y dimension screen
#define XDBTNM     55  //mode buttons dimension X
#define YDBTNM     40  //mode buttons dimension Y
#define XYDL       20  //LED dimension X & Y
#define XDBGP   (470-(XDBTNM*6))/7  //dimension of x distance between buttons = total X dimension - qty buttons * lenBTNs / qty gaps
#define XDLGP   (470-(XYDL*6))/7    //dimension of x distance between LEDs = total X dimension - qty LEDs * lenLED / qty gaps

#define YPBTNM     175  //y position of mode buttons 
#define YPLED      135 // y position of LEDs

#define GUI_EXTRALIGHTGRAY     0x00F0F0F0 //Was 0x00E0E0E0


static void Startup(WM_HWIN hWin, uint16_t xpos, uint16_t ypos);
static void ChkLedImgs(WM_HWIN hWin,uint16_t almreg);
static void TextDirectOpen(char *filename);

void DrawRects(WM_MESSAGE *pMsg);
void DrawRect(WM_HWIN hWin);

void SaveXYs(WM_MESSAGE *pMsg);
void SaveXY(WM_HWIN hWin, int Index);

void MoveObjects(WM_MESSAGE *pMsg);
void MoveObjectsBack(WM_MESSAGE *pMsg);

char MovedObjects = 0;


K_ModuleItem_Typedef  iccp_main =
{
  1,
  "ICCP Defender",
  &bmdefender_shield_trans,
  Startup,
  TextDirectOpen,
};

WM_HWIN iccpmain_hdl;

static const char _acDpdn[8][16] =
{
  {"NODE 0 CAN ON"},
  {"NODE 1 CAN ON"},
  {"NODE 2 CAN ON"},
  {"NODE 3 CAN ON"},
	{"NODE 0 CANOFF"},
  {"NODE 1 CANOFF"},
  {"NODE 2 CANOFF"},
  {"NODE 3 CANOFF"},
};

typedef struct
{
		char last_psuadr[4];
		uint16_t last_almreg[4];
		uint16_t lastVrd[4];
	  uint16_t lastIrd[4];
} ScreenData_t;

ScreenData_t lastdata;

GUI_RECT tmpRect;
int GUI_Style = 0;
int GUI_Style_Last = 0;

int XY[10][4] = {0};

int GUI_Style_Timeout = 0;
int GUI_Style_Count = 0;
char FrameText[32];
// USER END

/*********************************************************************
*
*       Defines
*
**********************************************************************
*/
#define ID_FRAMEWIN_0 (GUI_ID_USER + 0x00)
#define ID_BUTTON_0 (GUI_ID_USER + 0x01)  //CV
#define ID_BUTTON_1 (GUI_ID_USER + 0x02)  //CI
#define ID_TEXT_0 (GUI_ID_USER + 0x03)    //AMPS SET
#define ID_TEXT_1 (GUI_ID_USER + 0x04)    //AMPS LABEL
#define ID_TEXT_2 (GUI_ID_USER + 0x05)    //VOLTS SET
#define ID_TEXT_3 (GUI_ID_USER + 0x06)    //VOLTS LABEL
#define ID_BUTTON_2 (GUI_ID_USER + 0x07)  //CP
#define ID_TEXT_4 (GUI_ID_USER + 0x08)    //TITLE
#define ID_IMAGE_0 (GUI_ID_USER + 0x09)   //Logo 


#define ID_BUTTON_3 (GUI_ID_USER + 0x0A)  // ENABLE
#define ID_BUTTON_4 (GUI_ID_USER + 0x0B)  // HOME
#define ID_BUTTON_5 (GUI_ID_USER + 0x0C)  //SETUP
#define ID_BUTTON_6 (GUI_ID_USER + 0x0D)  //LOG

#define ID_IMAGE_1 (GUI_ID_USER + 0x0E)  //ACLED
#define ID_IMAGE_2 (GUI_ID_USER + 0x0F)  //DCLED
#define ID_IMAGE_3 (GUI_ID_USER + 0x10)  //RECTLED
#define ID_IMAGE_4 (GUI_ID_USER + 0x11)  //SURGELED
#define ID_IMAGE_5 (GUI_ID_USER + 0x12)  //REFELECTLED
#define ID_IMAGE_6 (GUI_ID_USER + 0x13)  //COMMLED

#define ID_TMR_UPDTMAIN (GUI_ID_USER + 0x14)  // timer used to update data on iccpmain scrn
#define ID_DROPDOWN_PSUVW (GUI_ID_USER + 0x15)  //Dropdown PSU Viewing Selector
#define ID_TEXT_AC (GUI_ID_USER + 0x16)    //ACOK FLT TEXT
#define ID_TEXT_DC (GUI_ID_USER + 0x17)    //DCOK FLT TEXT
#define ID_TEXT_RCT (GUI_ID_USER + 0x18)    //RECT FLT TEXT
#define ID_TEXT_SRG (GUI_ID_USER + 0x19)    //SURGE FLT TEXT
#define ID_TEXT_REF (GUI_ID_USER + 0x1A)    //REF ELECTRODE FLT TEXT
#define ID_TEXT_COM (GUI_ID_USER + 0x1B)    //COM FLT TEXT
#define ID_IMAGE_IO (GUI_ID_USER + 0x1C)  //ON\OFF LED

//START: For GUI_Style == 1
#define ID_TXT_STA_EN (GUI_ID_USER + 0x1D)  //ON\OFF LED
#define ID_TXT_STA_AC (GUI_ID_USER + 0x1E)  //ACOK FLT TEXT
#define ID_TXT_STA_DC (GUI_ID_USER + 0x1F)  //DCOK FLT TEXT
#define ID_TXT_STA_REC (GUI_ID_USER + 0x20)  //RECT FLT TEXT
#define ID_TXT_STA_SRG (GUI_ID_USER + 0x21)  //SURGE FLT TEXT
#define ID_TXT_STA_REF (GUI_ID_USER + 0x22)  //REF ELECTRODE FLT TEXT
#define ID_TXT_STA_COM (GUI_ID_USER + 0x23)  //COM FLT TEXT
//END: For GUI_Style == 1

#define ID_BUTTON_SCAN (GUI_ID_USER + 0x24)  //SCAN NODES - When NODE goes into CAN Lockout


#define ID_IMAGE_0_IMAGE_0 0x00  // ATDILOGO
#define ID_IMAGE_0_IMAGE_1 0x01  //GRN LED ON
#define ID_IMAGE_0_IMAGE_2 0x02  //GRN LED OFF
#define ID_IMAGE_OFF_GRAY_40x8 0x03  //GRN LED OFF
#define ID_IMAGE_ON_GRN_40x8 0x04  //GRN LED ON
#define ID_IMAGE_ON_RED_20x20 0x05  //RED LED ON
#define ID_IMAGE_OFF_GRAY_20x20 0x06  //GRAY LED OFF

// USER END

/*********************************************************************
*
*       Static data
*
**********************************************************************
*/


// USER START (Optionally insert additional static data)
/*********************************************************************
*
*       _acImage_0, "C:\Users\keipe_v.TRANSDEV.COM\Pictures\leds\iccp_off_grn_20x20.bmp", ID_IMAGE_0_IMAGE_2
*/
static const U8 _acImg_grnoff[1254] = {
  0x42, 0x4D, 0xE6, 0x04, 0x00, 0x00, 0x00, 0x00, 0x00, 0x00, 0x36, 0x00,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 0x00,
  0x00, 0x00, 0x00, 0x00, 0x00, 0x00, 0x00, 0x00, 0x00, 0x00, 0x00, 0x00,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 0xE3,
  0xE1, 0xE7, 0xE2, 0xE5, 0xEA, 0xE6, 0xF9, 0xFA, 0xF9, 0xFF, 0xFF, 0xFF,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 0xFF,
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  0xCC, 0xCD, 0xCC, 0xD3, 0xD6, 0xD5, 0xD5, 0xDA, 0xD7, 0xCE, 0xD2, 0xD0,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 0xFF,
};

/*********************************************************************
*
*       _acImage_1, "C:\Users\keipe_v.TRANSDEV.COM\Pictures\leds\iccp_on_grn_20x20.bmp", ID_IMAGE_1_IMAGE_0
*        Green ON Led 20x20
*/
static const U8 _acImg_grnon[1254] = {
  0x42, 0x4D, 0xE6, 0x04, 0x00, 0x00, 0x00, 0x00, 0x00, 0x00, 0x36, 0x00,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 0x00,
  0x00, 0x00, 0x00, 0x00, 0x00, 0x00, 0x00, 0x00, 0x00, 0x00, 0x00, 0x00,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 0x73,
  0x6E, 0x85, 0x72, 0x74, 0x88, 0x77, 0x90, 0x9F, 0x92, 0xC3, 0xD0, 0xC6,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 0xFE,
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  0xC0, 0xBF, 0xC1, 0xCA, 0xCB, 0xC8, 0xCA, 0xCA, 0xC6, 0xBB, 0xBF, 0xBA,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 0xFF,
};

/*********************************************************************
*
*       _acImage_11, "C:\Keil_v5\ARM\Segger\emWin\Tool\GUI_res\leds\iccp_off_gray_40x8_sq.bmp", ID_IMAGE_11_IMAGE_0
*/
static const U8 _acImage_off_gray_40x8_sq[1014] = {
  0x42, 0x4D, 0xF6, 0x03, 0x00, 0x00, 0x00, 0x00, 0x00, 0x00, 0x36, 0x00,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 0x00,
  0x00, 0x00, 0x00, 0x00, 0x00, 0x00, 0x00, 0x00, 0x00, 0x00, 0x00, 0x00,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 0x00,
  0x00, 0x00, 0x00, 0x00, 0x00, 0x00, 0x00, 0x00, 0x00, 0x00, 0x00, 0x00,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 0x00,
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  0x00, 0x00, 0x00, 0x00, 0x00, 0x00,
};

/*********************************************************************
*
*       _acImage_12, "C:\Keil_v5\ARM\Segger\emWin\Tool\GUI_res\leds\iccp_on_grn_40x8_sq.bmp", ID_IMAGE_12_IMAGE_0
*/
static const U8 _acImage_on_grn_40x8_sq[1014] = {
  0x42, 0x4D, 0xF6, 0x03, 0x00, 0x00, 0x00, 0x00, 0x00, 0x00, 0x36, 0x00,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 0x00,
  0x00, 0x00, 0x00, 0x00, 0x00, 0x00, 0x00, 0x00, 0x00, 0x00, 0x00, 0x00,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 0x00,
  0x00, 0x00, 0x00, 0x00, 0x00, 0x00, 0x00, 0x00, 0x00, 0x00, 0x00, 0x00,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 0x00,
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  0x00, 0x00, 0x00, 0x00, 0x00, 0x00,
};

/*********************************************************************
*
*       _acImage_8, "C:\Keil_v5\ARM\Segger\emWin\Tool\GUI_res\leds\iccp_on_red_20x20.bmp", ID_IMAGE_8_IMAGE_0
*/
static const U8 _acImage_on_red_20x20[1654] = {
  0x42, 0x4D, 0x76, 0x06, 0x00, 0x00, 0x00, 0x00, 0x00, 0x00, 0x36, 0x00,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 0x00,
  0x00, 0x00, 0x00, 0x00, 0x00, 0x00, 0x00, 0x00, 0x00, 0x00, 0x00, 0x00,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 0x9F,
  0xA6, 0xFF, 0x70, 0x7C, 0x94, 0xFF, 0x67, 0x73, 0x8F, 0xFF, 0x69, 0x78,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 0xFF,
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  0xFF, 0xFF, 0xFF, 0xFF, 0xFF, 0xFF, 0xFF, 0xFF, 0xFF, 0xFF, 0xFF, 0xFF, 0xFF, 0xFF, 0xFF, 0xFF,
};

/*********************************************************************
*
*       _acImage_9, "C:\Keil_v5\ARM\Segger\emWin\Tool\GUI_res\leds\iccp_off_gray_20x20.bmp", ID_IMAGE_9_IMAGE_0
*/
static const U8 _acImage_off_gray_20x20[1654] = {
  0x42, 0x4D, 0x76, 0x06, 0x00, 0x00, 0x00, 0x00, 0x00, 0x00, 0x36, 0x00,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 0x00,
  0x00, 0x00, 0x00, 0x00, 0x00, 0x00, 0x00, 0x00, 0x00, 0x00, 0x00, 0x00,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 0x9C,
  0x9C, 0xFF, 0x7D, 0x7D, 0x7D, 0xFF, 0x73, 0x73, 0x73, 0xFF, 0x73, 0x73,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 0xFF,
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  0xFF, 0xFF, 0xFF, 0xFF, 0xFF, 0xFF, 0xFF, 0xFF, 0xFF, 0xFF, 0xFF, 0xFF, 0xFF, 0xFF, 0xFF, 0xFF,
};


extern WM_HWIN Createiccp_gyt(void);
extern WM_HWIN Createiccp_gph(void);
extern WM_HWIN Createiccp_pm(void);
extern WM_HWIN Createiccp_cp(void);
extern WM_HWIN Createiccp_cv(void);
extern WM_HWIN Createiccp_ci(void);

extern int GUImode;

/*********************************************************************
*
*       _GetImageById
*/
//#define ID_IMAGE_OFF_GRAY_40x8 0x03  //GRN LED OFF
//#define ID_IMAGE_ON_GRN_40x8 0x04  //GRN LED ON
static const void * _GetImageById(U32 Id, U32 * pSize) {
  switch (Id) {
  case ID_IMAGE_0_IMAGE_0:
   // *pSize = sizeof(_acImage_0);
   // return (const void*)_acImage_0;
		
	case ID_IMAGE_0_IMAGE_1:  // any green pn led 20x20pixels
    *pSize = sizeof(_acImg_grnon);
    return (const void *)_acImg_grnon;
	case ID_IMAGE_0_IMAGE_2:  // any green pn led 20x20pixels
    *pSize = sizeof(_acImg_grnoff);
    return (const void *)_acImg_grnoff;
	case ID_IMAGE_OFF_GRAY_40x8:  // any green pn led 20x20pixels
    *pSize = sizeof(_acImage_off_gray_40x8_sq);
    return (const void *)_acImage_off_gray_40x8_sq;
	case ID_IMAGE_ON_GRN_40x8:  // any green pn led 20x20pixels
    *pSize = sizeof(_acImage_on_grn_40x8_sq);
    return (const void *)_acImage_on_grn_40x8_sq;
	case ID_IMAGE_ON_RED_20x20:  // any green pn led 20x20pixels
    *pSize = sizeof(_acImage_on_red_20x20);
    return (const void *)_acImage_on_red_20x20;
	case ID_IMAGE_OFF_GRAY_20x20:  // any green pn led 20x20pixels
    *pSize = sizeof(_acImage_off_gray_20x20);
    return (const void *)_acImage_off_gray_20x20;
  }
  return NULL;
}

// USER END

/*********************************************************************
*
*       _aDialogCreate
*FRAMEWIN_Handle FRAMEWIN_CreateIndirect(const GUI_WIDGET_CREATE_INFO * pCreateInfo, WM_HWIN hWinParent, int x0, int y0, WM_CALLBACK * cb);
*
*																												  x        y  xSz  Ysz              */
static const GUI_WIDGET_CREATE_INFO _aDialogCreate[] = {
  { FRAMEWIN_CreateIndirect, "iccp_main", ID_FRAMEWIN_0,  0,       0, XSCN, YSCN, 0, 0x64, 0 },
  { IMAGE_CreateIndirect, "atdilogo_bmp", ID_IMAGE_0,      0,       0, 240, 50, 0, 0, 0 },
	{ DROPDOWN_CreateIndirect, "PsuVwDrpdn", ID_DROPDOWN_PSUVW,250,             5,          140,40,   0, 0x0, 0 },
	{ BUTTON_CreateIndirect, "SCAN NODES", ID_BUTTON_SCAN,250,             5,          140,40,   0, 0x0, 0 },
	{ BUTTON_CreateIndirect, "DC OFF",       ID_BUTTON_3, XSCN-(XDBTNM+20),        5,  XDBTNM, YDBTNM, 0, 0x0, 0 },
	{ IMAGE_CreateIndirect, "onoff_bmp",      ID_IMAGE_IO, XSCN-((XDBTNM/2)+30), YDBTNM +15,            20,           20, 0,   0, 0 },
  
//  { TEXT_CreateIndirect, "Amps_txt", ID_TEXT_0,          294, 47, 160, 40, 0, 0x0, 0 },  //IRDB
//  { TEXT_CreateIndirect, "Amps", ID_TEXT_1,              235, 57,  53, 20, 0, 0x0, 0 },// Irdb label
//  { TEXT_CreateIndirect, "Volts_txt", ID_TEXT_2,          72, 47, 160, 40, 0, 0, 0 },   //VRDB
//  { TEXT_CreateIndirect, "Volts", ID_TEXT_3,              10, 57,  53, 20, 0, 0, 0 },   //Vrdb label


  { TEXT_CreateIndirect, "VOLTS",     ID_TEXT_3,          10, 57,  68, 40, 0, 0, 0 },   //Vrdb label
  { TEXT_CreateIndirect, "Volts_txt", ID_TEXT_2,          78, 57, 125, 40, 0, 0, 0 },   //VRDB
  
  { TEXT_CreateIndirect, "AMPS", 	  ID_TEXT_1,          215, 57,  68, 40, 0, 0x0, 0 },// Irdb label
  { TEXT_CreateIndirect, "Amps_txt",  ID_TEXT_0,          283, 57, 125, 40, 0, 0x0, 0 },  //IRDB
  
	{ TEXT_CreateIndirect, "AC"          , ID_TEXT_AC,             XDLGP-10, YPLED-30,  44, 32, 0, 0, 0 },
  { TEXT_CreateIndirect, "DC"          , ID_TEXT_DC,  (XYDL*1+XDLGP*2)-10, YPLED-30,  44, 32, 0, 0, 0 },
	{ TEXT_CreateIndirect, "REC"         , ID_TEXT_RCT,(XYDL*2+XDLGP*3)-10, YPLED-30,  44, 32, 0, 0, 0 },
  { TEXT_CreateIndirect, "SURGE"       , ID_TEXT_SRG,(XYDL*3+XDLGP*4)-20, YPLED-30,  64, 32, 0, 0, 0 },
  { TEXT_CreateIndirect, "REF"         , ID_TEXT_REF,(XYDL*4+XDLGP*5)-10, YPLED-30,  44, 32, 0, 0, 0 },
  { TEXT_CreateIndirect, "COM"         , ID_TEXT_COM,(XYDL*5+XDLGP*6)-10, YPLED-30,  44, 32, 0, 0, 0 },
  
  { IMAGE_CreateIndirect, "acokled_bmp", ID_IMAGE_1,              XDLGP,    YPLED,  20, 20, 0, 0, 0 },
  { IMAGE_CreateIndirect, "dcokled_bmp", ID_IMAGE_2,     XYDL*1+XDLGP*2,    YPLED,  20, 20, 0, 0, 0 },
	{ IMAGE_CreateIndirect, "rectled_bmp", ID_IMAGE_3,     XYDL*2+XDLGP*3,    YPLED,  20, 20, 0, 0, 0 },
	{ IMAGE_CreateIndirect, "surgeled_bmp", ID_IMAGE_4,    XYDL*3+XDLGP*4,    YPLED,  20, 20, 0, 0, 0 },
	{ IMAGE_CreateIndirect, "refelectled_bmp", ID_IMAGE_5, XYDL*4+XDLGP*5,    YPLED,  20, 20, 0, 0, 0 },
	{ IMAGE_CreateIndirect, "commfltled_bmp", ID_IMAGE_6,  XYDL*5+XDLGP*6,    YPLED,  20, 20, 0, 0, 0 },
  
  { BUTTON_CreateIndirect, "HOME",ID_BUTTON_4,                   XDBGP, YPBTNM,  XDBTNM, YDBTNM, 0, 0x0, 0 },
  { BUTTON_CreateIndirect, "CV_Btn",ID_BUTTON_0,XDBTNM*1+XDBGP*2, YPBTNM, XDBTNM, YDBTNM, 0, 0x0, 0 },
  { BUTTON_CreateIndirect, "CI", ID_BUTTON_1,   XDBTNM*2+XDBGP*3, YPBTNM, XDBTNM, YDBTNM, 0, 0x0, 0 },
  { BUTTON_CreateIndirect, "CP", ID_BUTTON_2,   XDBTNM*3+XDBGP*4, YPBTNM, XDBTNM, YDBTNM, 0, 0x0, 0 },
  { BUTTON_CreateIndirect, "ADMIN",ID_BUTTON_5, XDBTNM*4+XDBGP*5, YPBTNM,  XDBTNM, YDBTNM, 0, 0x0, 0 },
  { BUTTON_CreateIndirect, "LOG",ID_BUTTON_6,   XDBTNM*5+XDBGP*6, YPBTNM,  XDBTNM, YDBTNM, 0, 0x0, 0 },
  
  { TEXT_CreateIndirect, "ON", ID_TXT_STA_EN, XSCN-((XDBTNM/2)+25), YDBTNM +15,            20,           YDBTNM, 0,   0, 0 },
};

/*
**********************************************************************
*
*       Static code
*
**********************************************************************
*/

// USER START (Optionally insert additional static code)
// USER END

/*********************************************************************
*
*       _cbDialog
*/
WM_HWIN hWin;
static void _cbDialog(WM_MESSAGE * pMsg) 
{
  WM_HWIN hItem;
  int     NCode;
  int     Id;
  const void * pData;
	const void * pImgData;
	const void * pImgDataOn;
	const void * pImgDataOff;
  U32          FileSize;
	uint8_t i;

	char chbuff[12];
	
	// USER START (Optionally insert additional variables)
  BUTTON_SKINFLEX_PROPS BtnProps;
	FRAMEWIN_SKINFLEX_PROPS FrmProps;
	DROPDOWN_SKINFLEX_PROPS DrpdnProps;
  
	hWin = pMsg->hWin;
	// USER END

  switch (pMsg->MsgId) 
	{
			case WM_INIT_DIALOG:
						//For all LISTVIEW widgets - EAJ 1/25/2016
						LISTVIEW_SetDefaultGridColor(GUI_LIGHTGRAY);
				
						// Initialization of 'iccp_main'
						//
						hItem = pMsg->hWin;
						FRAMEWIN_SetTitleVis(hItem, 1);
						//FRAMEWIN_SetTitleHeight(hItem, 25);
						FRAMEWIN_SetFont(hItem, GUI_FONT_16_1);
						FRAMEWIN_SetText(hItem, "ICCP Defender Main");
						FRAMEWIN_SetTextAlign(hItem, GUI_TA_HCENTER | GUI_TA_VCENTER);
						FRAMEWIN_SetSkin(hItem,FRAMEWIN_SKIN_FLEX);
						FRAMEWIN_SetClientColor(hItem,GUI_WHITE);
						FRAMEWIN_AddCloseButton(hItem, FRAMEWIN_BUTTON_RIGHT, 0);

//					sprintf(titlestr,"Profile Manager Screen for NODE: %i",GuiState.psu_viewing);
//								hItem = pMsg->hWin;
//								hFramePMgr = hItem;
//								FRAMEWIN_SetFont(hItem, GUI_FONT_16B_1);
//								FRAMEWIN_SetText(hItem, titlestr );
//								FRAMEWIN_SetTextAlign(hItem, GUI_TA_HCENTER | GUI_TA_VCENTER);
//								FRAMEWIN_SetClientColor(hItem,GUI_WHITE);  
//								FRAMEWIN_SetSkin(hItem,FRAMEWIN_SKIN_FLEX);			
						
						//
						// Initialization of 'CV_Btn'
						//
						hItem = WM_GetDialogItem(pMsg->hWin, ID_BUTTON_0);
						BUTTON_SetText(hItem, "CV");
						BUTTON_SetFont(hItem, GUI_FONT_13B_1);
						BUTTON_SetSkin(hItem,BUTTON_SKIN_FLEX);
						//
						// Initialization of 'CI'
						//
						hItem = WM_GetDialogItem(pMsg->hWin, ID_BUTTON_1);
						BUTTON_SetFont(hItem, GUI_FONT_13B_1);
						BUTTON_SetSkin(hItem,BUTTON_SKIN_FLEX);
						// Initialization of 'CP'
						//
						hItem = WM_GetDialogItem(pMsg->hWin, ID_BUTTON_2);
						BUTTON_SetFont(hItem, GUI_FONT_13B_1);
						BUTTON_SetSkin(hItem,BUTTON_SKIN_FLEX);
						//
						// Initialization of 'ENABLE'
						//
						hItem = WM_GetDialogItem(pMsg->hWin, ID_BUTTON_3);
						BUTTON_SetFont(hItem, GUI_FONT_13_1);
						BUTTON_SetSkin(hItem,BUTTON_SKIN_FLEX);
						BUTTON_SetFocussable(hItem,0);
  					
						//
						// Initialization of 'HOME'
						//
						hItem = WM_GetDialogItem(pMsg->hWin, ID_BUTTON_4);
						BUTTON_SetFont(hItem, GUI_FONT_13_1);
						BUTTON_SetSkin(hItem,BUTTON_SKIN_FLEX);
						//
						// Initialization of 'SETUP'
						//
						hItem = WM_GetDialogItem(pMsg->hWin, ID_BUTTON_5);
						BUTTON_SetFont(hItem, GUI_FONT_13_1);
						BUTTON_SetSkin(hItem,BUTTON_SKIN_FLEX);
						BUTTON_SetFocussable(hItem,0);
  					//
						// Initialization of 'LOG'
						//
						hItem = WM_GetDialogItem(pMsg->hWin, ID_BUTTON_6);
						BUTTON_SetFont(hItem, GUI_FONT_13_1);
						BUTTON_SetSkin(hItem,BUTTON_SKIN_FLEX);
						BUTTON_SetFocussable(hItem,0);
  					//
						// Initialization of 'ID_BUTTON_SCAN'
						//
						hItem = WM_GetDialogItem(pMsg->hWin, ID_BUTTON_SCAN);
						BUTTON_SetFont(hItem, GUI_FONT_13_1);
						BUTTON_SetSkin(hItem,BUTTON_SKIN_FLEX);
						//BUTTON_SetTextAlign(hItem, GUI_TA_HCENTER | GUI_TA_VCENTER);
						BUTTON_SetFocussable(hItem,0);
  					//
						// Initialization of 'Amps_txt'
						//
						hItem = WM_GetDialogItem(pMsg->hWin, ID_TEXT_0);
						TEXT_SetTextAlign(hItem, GUI_TA_HCENTER | GUI_TA_VCENTER);
						TEXT_SetFont(hItem, GUI_FONT_D24X32);
						//sprintf(dbgstr,"%3.0f",(float)GuiState.SysDataPSU[GuiState.psu_viewing].Irdbk /10);
						//TEXT_SetText(hItem, dbgstr);
						TEXT_SetTextColor(hItem, GUI_GRAY);
						
						//TEXT_SetBkColor(WM_GetDialogItem(pMsg->hWin, ID_TEXT_0), GUI_EXTRALIGHTGRAY);
						//TEXT_SetBkColor(WM_GetDialogItem(pMsg->hWin, ID_TEXT_1), GUI_EXTRALIGHTGRAY); //Amps Label
						//TEXT_SetBkColor(WM_GetDialogItem(pMsg->hWin, ID_TEXT_2), GUI_EXTRALIGHTGRAY);
						//TEXT_SetBkColor(WM_GetDialogItem(pMsg->hWin, ID_TEXT_3), GUI_EXTRALIGHTGRAY); //Voltss Label
						WM_HideWindow(WM_GetDialogItem(pMsg->hWin, ID_TXT_STA_EN));
						
//						uint32_t bytesread;                     /* File write/read counts */
//						uint8_t rtext[100];                                   /* File read buffer */
//		

//						FRESULT fr;
//						FIL fil;

//						
//						/* Open or create a log file and ready to append */
//						fr = f_open(&fil, "1:/default.txt",FA_OPEN_ALWAYS | FA_WRITE);
//						if (fr == FR_OK) 
//						{
//								TEXT_SetText(hItem, "WR FAIL");
//						}

//						/* Append a line */
//						f_printf(&fil, "%02u/%02u/%u, %2u:%02u\n", 0, 1, 2015, 2, 34);

//						/* Close the file */
//						f_close(&fil);


//							
//						/*##-4- Open a text file object with write access #####*/
//						if(f_open(&fil, "1:/default.txt", FA_READ) != FR_OK)
//						{
//									/* 'STM32.TXT' file Open for write Error */
//									TEXT_SetText(hItem, "RD FAIL");
//						}
//						else
//						{
//									/*##-8- Read data from the text file ###########################*/
//									fr = f_read(&fil, rtext, 100, (UINT*)&bytesread);
//									
//									if((bytesread == 0) || (fr != FR_OK))
//									{
//										/* 'STM32.TXT' file Read or EOF Error */
//																		TEXT_SetText(hItem, "NO BYTES");
//									}
//									else
//									{
//										/*##-9- Close the open text file #############################*/
//										f_close(&fil);
//										TEXT_SetText(hItem, (char *)rtext);
//									}
//						}
						
						
						//
						// Initialization of 'Amps'
						//
						hItem = WM_GetDialogItem(pMsg->hWin, ID_TEXT_1);
						TEXT_SetTextAlign(hItem, GUI_TA_HCENTER | GUI_TA_VCENTER);
						TEXT_SetFont(hItem, GUI_FONT_20_1);
						TEXT_SetTextColor(hItem, 0x00FF0000);
						//TEXT_SetTextColor(hItem, GUI_BLACK);
						
						// Initialization of 'Volts_txt'
						//
						hItem = WM_GetDialogItem(pMsg->hWin, ID_TEXT_2);
						TEXT_SetTextAlign(hItem, GUI_TA_HCENTER | GUI_TA_VCENTER);
						TEXT_SetFont(hItem, GUI_FONT_D24X32);
						if(cvmode_vset ==0){strncpy(dbgstr,"OFF",3);}
						else{sprintf(dbgstr,"%2.1f",(float)GuiState.SysDataPSU[GuiState.psu_viewing].Irdbk/10);}
						TEXT_SetText(hItem, dbgstr);
						TEXT_SetTextColor(hItem, GUI_GRAY);
						//
						// Initialization of 'Volts'
						//
						hItem = WM_GetDialogItem(pMsg->hWin, ID_TEXT_3);
						TEXT_SetTextAlign(hItem, GUI_TA_HCENTER | GUI_TA_VCENTER);
						TEXT_SetFont(hItem, GUI_FONT_20_1);
						TEXT_SetTextColor(hItem, 0x00FF0000);
						//TEXT_SetTextColor(hItem, GUI_BLACK);
						
						BUTTON_GetSkinFlexProps(&BtnProps, BUTTON_SKINFLEX_PI_ENABLED);
						BtnProps.aColorFrame[0] = 0x000000C8;
						BtnProps.aColorFrame[1] = 0x007896FE;
						BtnProps.Radius = 6;
						BUTTON_SetSkinFlexProps(&BtnProps, BUTTON_SKINFLEX_PI_ENABLED);
						
						// Set Green outline when focused
						BUTTON_GetSkinFlexProps(&BtnProps, BUTTON_SKINFLEX_PI_PRESSED);
						BtnProps.aColorFrame[0] = 0x007FB13C;
						BtnProps.aColorFrame[1] = 0x008FfF8F;
						BtnProps.Radius = 6;
						BUTTON_SetSkinFlexProps(&BtnProps, BUTTON_SKINFLEX_PI_PRESSED);
						
						// Set Green outline when focused
						FRAMEWIN_GetSkinFlexProps(&FrmProps, FRAMEWIN_SKINFLEX_PI_ACTIVE);
						FrmProps.aColorFrame[0] = 0x000000C8;
						FrmProps.aColorFrame[1] = GUI_WHITE;
						FrmProps.aColorFrame[2] = GUI_WHITE;
						FrmProps.Radius = 6;
						FRAMEWIN_SetSkinFlexProps(&FrmProps, FRAMEWIN_SKINFLEX_PI_ACTIVE);
						
						//
						// Initialization of 'Amps'
						//
						hItem = WM_GetDialogItem(pMsg->hWin, ID_TEXT_4);
						TEXT_SetTextAlign(hItem, GUI_TA_HCENTER | GUI_TA_VCENTER);
						TEXT_SetFont(hItem, GUI_FONT_20_1);
						TEXT_SetTextColor(hItem, GUI_GRAY);
						
						// Set Edit Box
						// Load images LEDS & Logo
						// Load ATDILogo
						hItem = WM_GetDialogItem(pMsg->hWin, ID_IMAGE_0);
						pData = _GetImageById(ID_IMAGE_0_IMAGE_0, &FileSize);
						//IMAGE_SetBMP(hItem, pData, FileSize);
						IMAGE_SetBitmap (hItem, &bmAtdi_logo_small_trans);
    
						
						
						// Load ACLED
						hItem = WM_GetDialogItem(pMsg->hWin, ID_IMAGE_1);
						pData = _GetImageById(ID_IMAGE_0_IMAGE_1, &FileSize);
						IMAGE_SetBMP(hItem, pData, FileSize);
						
						// Load DCLED
						hItem = WM_GetDialogItem(pMsg->hWin, ID_IMAGE_2);
						pData = _GetImageById(ID_IMAGE_0_IMAGE_1, &FileSize);
						IMAGE_SetBMP(hItem, pData, FileSize);
						
						// Load RECT FLT LED
						hItem = WM_GetDialogItem(pMsg->hWin, ID_IMAGE_3);
						pData = _GetImageById(ID_IMAGE_0_IMAGE_1, &FileSize);
						IMAGE_SetBMP(hItem, pData, FileSize);
						
						// Load SURGE LED
						hItem = WM_GetDialogItem(pMsg->hWin, ID_IMAGE_4);
						pData = _GetImageById(ID_IMAGE_0_IMAGE_1, &FileSize);
						IMAGE_SetBMP(hItem, pData, FileSize);
						
						// Load REF ELECTRODE LED
						hItem = WM_GetDialogItem(pMsg->hWin, ID_IMAGE_5);
						pData = _GetImageById(ID_IMAGE_0_IMAGE_1, &FileSize);
						IMAGE_SetBMP(hItem, pData, FileSize);
						
						// Load COMM LED
						hItem = WM_GetDialogItem(pMsg->hWin, ID_IMAGE_6);
						pData = _GetImageById(ID_IMAGE_0_IMAGE_1, &FileSize);
						IMAGE_SetBMP(hItem, pData, FileSize);

						// Load RECTIFIER ON\OFF LED CFG
						hItem = WM_GetDialogItem(pMsg->hWin, ID_IMAGE_IO);
						pData = _GetImageById(ID_IMAGE_0_IMAGE_1, &FileSize);
						IMAGE_SetBMP(hItem, pData, FileSize);
						
						TEXT_SetBkColor(WM_GetDialogItem(pMsg->hWin, ID_TXT_STA_EN), GUI_GREEN);
						
						//
						// Init PSU Viewing Slector Dropdown
						//
						hItem = WM_GetDialogItem(pMsg->hWin, ID_DROPDOWN_PSUVW);
						DROPDOWN_SetSkin(hItem,DROPDOWN_SKIN_FLEX);
						DROPDOWN_GetSkinFlexProps(&DrpdnProps, DROPDOWN_SKINFLEX_PI_FOCUSSED);
						DrpdnProps.ColorArrow = GUI_DARKGRAY;
						DrpdnProps.Radius = 6;
						DROPDOWN_SetSkinFlexProps(&DrpdnProps, DROPDOWN_SKINFLEX_PI_FOCUSSED);

						for(i=0;i<4;i++)
						{			
								if(GuiState.SysDataPSU[i].PSU_ADDR == 0x00ff)
								{
											DROPDOWN_DeleteItem(hItem,i); // delete the line so we can add the new data in that line index
											DROPDOWN_InsertString(hItem,_acDpdn[i+4],i);// write the "PSU OFFx" where x = PSU that responded
											DROPDOWN_SetItemDisabled(hItem,i,1);
								}
								else
								{
											DROPDOWN_DeleteItem(hItem,i); // delete the line so we can add the new data in that line index
											DROPDOWN_InsertString(hItem,_acDpdn[i],i);// write the "PSU ADRx" where x = PSU that responded
											DROPDOWN_SetItemDisabled(hItem,i,0);
								}
						}
						DROPDOWN_SetListHeight(hItem,DROPDOWN_GetNumItems(hItem)* 25);		
								
						DROPDOWN_SetSel(hItem,0);
						DROPDOWN_SetTextAlign(hItem, GUI_TA_HCENTER | GUI_TA_VCENTER);
						DROPDOWN_SetTextHeight(hItem,35); 
						DROPDOWN_SetItemSpacing(hItem, 10);
						DROPDOWN_SetColor(hItem,DROPDOWN_CI_ARROW,GUI_GRAY);
						
						WM_HideWindow(WM_GetDialogItem(pMsg->hWin, ID_BUTTON_SCAN));
						

						//DrawRects(pMsg);
						
						
						/*******************			START CFG FLT LEDS			****************************/
						for(i=0;i<6;i++)
						{
								switch (i)
								{
											case 0:
														hItem = WM_GetDialogItem(pMsg->hWin, ID_TEXT_AC);
											break;
											
											case 1:
														hItem = WM_GetDialogItem(pMsg->hWin, ID_TEXT_DC);
											break;
											
											case 2:
														hItem = WM_GetDialogItem(pMsg->hWin, ID_TEXT_RCT);
											break;
											
											case 3:
														hItem = WM_GetDialogItem(pMsg->hWin, ID_TEXT_REF);
											break;
											
											case 4:
														hItem = WM_GetDialogItem(pMsg->hWin, ID_TEXT_SRG);
											break;
											
											case 5:
														hItem = WM_GetDialogItem(pMsg->hWin, ID_TEXT_COM);
											break;
											
											
								}
								TEXT_SetTextAlign(hItem, GUI_TA_HCENTER | GUI_TA_VCENTER);
								TEXT_SetFont(hItem, GUI_FONT_20_1);
								TEXT_SetTextColor(hItem, 0x00FF0000);
						}
						/*******************			END CFg FLT LEDS			****************************/
						SaveXYs(pMsg);
						MovedObjects = 0;
						if(GuiState.style == 1)
						{
							MoveObjects(pMsg);
							DrawRects(pMsg);
						}
						else
						{
							MoveObjectsBack(pMsg);
						}
	
			break;// END CASE WM_INIT_DIALOG:
		
		
			case WM_NOTIFY_PARENT:
							Id    = WM_GetId(pMsg->hWinSrc);
							NCode = pMsg->Data.v;
							switch(Id) 
							{
								
								 case ID_IMAGE_0: // Notifications sent by 'ATDI Logo'
												switch(NCode) 
												{
															case WM_NOTIFICATION_RELEASED:
																  GUI_Style_Count++;
															
																	if((GUI_Style_Count>=3)&&(GUI_Style_Timeout<=10))
																	{
																			if(GuiState.demo == 0)
																			{
																					GuiState.demo = 1;
																			}
																			else
																			{
																					GuiState.demo = 0;
																			}
																			
																			GUI_Style_Last = GuiState.style;
																			
																			GUI_Style_Timeout = 0;
																			GUI_Style_Count = 0;
																	}
															break;
												}
												
											
								break;
												
								 case ID_BUTTON_SCAN: // Notifications sent by 'ID_BUTTON_SCAN'
												switch(NCode) 
												{
															case WM_NOTIFICATION_CLICKED:
																		if(GuiState.SysDataPSU[GuiState.psu_viewing].PSU_ADDR == 0x00ff)
																		{
																			//Add retry lockout clearing action
																			
																			for(i=0;i<4;i++)
																			{
																				GuiState.SysDataPSU[i].fail_lockout = 0;
																				GuiState.SysDataPSU[i].psufail_cnt = 0;
																				GuiState.SysDataPSU[i].Status &= 0xE0;
																			}
																			
																			WM_HideWindow(WM_GetDialogItem(pMsg->hWin, ID_BUTTON_SCAN));

																		}													
																		
															break;
												}
												
											
								break;
												

								
								 case ID_DROPDOWN_PSUVW: // Notifications sent by 'PsuVwDrpdn'
												switch(NCode) 
												{
//															case WM_NOTIFICATION_CLICKED:
//																		if(GuiState.SysDataPSU[GuiState.psu_viewing].PSU_ADDR == 0x00ff)
//																		{
//																			//Add retry lockout clearing action
//																			
//																			for(i=0;i<4;i++)
//																			{
//																				GuiState.SysDataPSU[i].fail_lockout = 0;
//																				GuiState.SysDataPSU[i].psufail_cnt = 0;
//																				GuiState.SysDataPSU[i].Status &= 0xE0;
//																			}
//																			{
//																			}
//																		}													
//																		
//															break;
															case WM_NOTIFICATION_SEL_CHANGED:
																		hItem = WM_GetDialogItem(pMsg->hWin, ID_DROPDOWN_PSUVW);
																		DROPDOWN_GetItemText(hItem,0,chbuff,10);
																		
																		if(strncmp(chbuff,"NODE",4)==0)
																		{
																				GuiState.psu_viewing = DROPDOWN_GetSelExp(hItem);
																		}
																		else
																		{
																				GuiState.psu_viewing = 0; // if no PSU is intialized yet always set to zero 
																		}
															break;
												}
												
											
								break;
								
								 case ID_BUTTON_0: // Notifications sent by 'CV_Btn'
													switch(NCode) 
													{			case WM_NOTIFICATION_CLICKED:
																		//Createiccp_cv();
																//break;
																case WM_NOTIFICATION_RELEASED:
																		Createiccp_cv();
																break;
													}
									break;
									
									case ID_BUTTON_1: // Notifications sent by 'CI'
													switch(NCode) 
													{
																case WM_NOTIFICATION_CLICKED:
																case WM_NOTIFICATION_RELEASED:
																		Createiccp_ci();
																break;
													}
									break;
									
									case ID_BUTTON_2: // Notifications sent by 'CP'
												switch(NCode) 
													{
																case WM_NOTIFICATION_CLICKED:
																case WM_NOTIFICATION_RELEASED:
																		Createiccp_cp();
																break;
													}
									break;
									
									case ID_BUTTON_4: // Notifications sent by 'Home_Btn'
													switch(NCode) 
													{
															case WM_NOTIFICATION_RELEASED:
																WM_DeleteWindow(pMsg->hWin);
																GuiState.gui_scn_state = G_MENU;
															break;
													}
									break;
									
									case ID_BUTTON_3: // Notifications sent by 'Enable_Btn'
													switch(NCode) 
													{
															case WM_NOTIFICATION_RELEASED:
																		hItem = WM_GetDialogItem(hWin, ID_BUTTON_3);
																		BUTTON_GetText(hItem,chbuff,10);
																		if(strncmp(chbuff,"DC OFF",6)==0)
																		{
																				BUTTON_SetPressed(hItem,0);// SET NOT PRESSED
																				BUTTON_SetText(hItem, "DC ON");
																				GuiState.SysDataPSU[GuiState.psu_viewing].Status &= 0xffdf; //and off REC SET on\off
																				GuiState.SysDataPSU[GuiState.psu_viewing].pflparams.last_psu_mode = GuiState.SysDataPSU[GuiState.psu_viewing].pflparams.psu_mode;
																			  GuiState.SysDataPSU[GuiState.psu_viewing].pflparams.psu_mode = P_OFF;
																				pData = _GetImageById(ID_IMAGE_0_IMAGE_2, &FileSize); // grn_led_off
																				pImgData = _GetImageById(ID_IMAGE_OFF_GRAY_40x8, &FileSize); // grn_led_off
																				BUTTON_SetBkColor(hItem, BUTTON_CI_UNPRESSED, GUI_GRAY);
																				TEXT_SetBkColor(WM_GetDialogItem(pMsg->hWin, ID_TXT_STA_EN), GUI_GRAY);
																		}
																		else
																		{
																				BUTTON_SetPressed(hItem,0);// SET PRESSED
																				BUTTON_SetText(hItem, "DC OFF");
																			  GuiState.SysDataPSU[GuiState.psu_viewing].Status |= 0x0020; //OR on REC SET on\off
																			  GuiState.SysDataPSU[GuiState.psu_viewing].pflparams.psu_mode = GuiState.SysDataPSU[GuiState.psu_viewing].pflparams.last_psu_mode;
																				pData = _GetImageById(ID_IMAGE_0_IMAGE_1, &FileSize); // grn_led_on
																				pImgData = _GetImageById(ID_IMAGE_ON_GRN_40x8, &FileSize); // grn_led_on
																				BUTTON_SetBkColor(hItem, BUTTON_CI_UNPRESSED, GUI_GREEN);
																				TEXT_SetBkColor(WM_GetDialogItem(pMsg->hWin, ID_TXT_STA_EN), GUI_GREEN);
																		}
																		// commit the IMG source change to each LED obj on this screen
																		hItem = WM_GetDialogItem(hWin, ID_IMAGE_IO);// find the LED obj we want to change
																		IMAGE_SetBMP(hItem, pData, FileSize);     // change the img source for the bmp img obj
																		
																		//hItem = WM_GetDialogItem(hWin, ID_BUTTON_3);
																		//BUTTON_SetBMP(hItem, BUTTON_BI_UNPRESSED, pData);XDBTNM, YDBTNM
																		if(GuiState.style == 1)
																		{
																			BUTTON_SetBMPEx(WM_GetDialogItem(hWin, ID_BUTTON_3), BUTTON_BI_UNPRESSED, pImgData,(XDBTNM-40)/2, YDBTNM-11);
																		}
																		
																		if(!GuiState.demo){while(!(BITCHK(GuiState.SysDataPSU[GuiState.psu_viewing].Status,3)));}//Wait for status update to complete
																		CANWrite(GuiState.psu_viewing,0x00,CMD_CAN_204,(uint8_t*)dbgstr,0);//EAJ 2016/01/12 send profile to PSU RAM
															break;
													}
									break;
													
									case ID_BUTTON_5: // Notifications sent by 'SETUP'
												switch(NCode) 
													{
																case WM_NOTIFICATION_RELEASED:
																		Createiccp_pm();
																break;
													}
									break;
									
								 case ID_BUTTON_6: // Notifications sent by 'Graph_Btn'
													switch(NCode) 
													{
																case WM_NOTIFICATION_RELEASED:
																		//Createiccp_gyt();
																break;
													}
									break;
									
												
													
							}//end switch ID CASE NOTIFY PARENT
			break;// END CASE NOTIFY PARENT

			case WM_PAINT:
			
			if(GUI_Style_Count>=1){GUI_Style_Timeout++;}
			
			if((GUI_Style_Count<=3)&&(GUI_Style_Timeout>=10))
			{			
					GUI_Style_Timeout = 0;
					GUI_Style_Count = 0;
			}
			
//			hItem = pMsg->hWin;
//			FRAMEWIN_SetText(hItem, "ICCP Defender Main2");
																	
//			sprintf(FrameText,"ICCP Defender Main: %i %i",GUI_Style_Count,GUI_Style_Timeout);
//			hItem = pMsg->hWin;
//			FRAMEWIN_SetText(hItem, FrameText);
			
//			WM_GetClientRectEx(WM_GetDialogItem(pMsg->hWin, ID_TEXT_0),&tmpRect);GUI_DrawRectEx(&tmpRect);
//			WM_GetClientRectEx(WM_GetDialogItem(pMsg->hWin, ID_TEXT_2),&tmpRect);GUI_DrawRectEx(&tmpRect);
			//BUTTON_SetBkColor(WM_GetDialogItem(hWin, ID_BUTTON_3), BUTTON_CI_UNPRESSED, GUI_GREEN);

						//if(GuiState.demo){GuiState.SysDataPSU[GuiState.psu_viewing].PSU_ADDR=0;}
						if(GuiState.demo){GuiState.SysDataPSU[0].PSU_ADDR=0;}
			
						if(GuiState.SysDataPSU[GuiState.psu_viewing].PSU_ADDR == 0x00ff)
						{
							//EAJ 2/4/2016  Works for now - rewrite when other nodes come into play
//  { BUTTON_CreateIndirect, "HOME",ID_BUTTON_4,                   XDBGP, YPBTNM,  XDBTNM, YDBTNM, 0, 0x0, 0 },
//  { BUTTON_CreateIndirect, "CV_Btn",ID_BUTTON_0,XDBTNM*1+XDBGP*2, YPBTNM, XDBTNM, YDBTNM, 0, 0x0, 0 },
//  { BUTTON_CreateIndirect, "CI", ID_BUTTON_1,   XDBTNM*2+XDBGP*3, YPBTNM, XDBTNM, YDBTNM, 0, 0x0, 0 },
//  { BUTTON_CreateIndirect, "CP", ID_BUTTON_2,   XDBTNM*3+XDBGP*4, YPBTNM, XDBTNM, YDBTNM, 0, 0x0, 0 },
//  { BUTTON_CreateIndirect, "ADMIN",ID_BUTTON_5, XDBTNM*4+XDBGP*5, YPBTNM,  XDBTNM, YDBTNM, 0, 0x0, 0 },
//  { BUTTON_CreateIndirect, "LOG",ID_BUTTON_6,   XDBTNM*5+XDBGP*6, YPBTNM,  XDBTNM, YDBTNM, 0, 0x0, 0 },
							//ID_BUTTON_0,1,2,5,6
							WM_HideWindow(WM_GetDialogItem(pMsg->hWin, ID_BUTTON_0));
							WM_HideWindow(WM_GetDialogItem(pMsg->hWin, ID_BUTTON_1));
							WM_HideWindow(WM_GetDialogItem(pMsg->hWin, ID_BUTTON_2));
							WM_HideWindow(WM_GetDialogItem(pMsg->hWin, ID_BUTTON_5));
							WM_HideWindow(WM_GetDialogItem(pMsg->hWin, ID_BUTTON_6));
							WM_HideWindow(WM_GetDialogItem(pMsg->hWin, ID_BUTTON_3)); //DC ON/OFF
							WM_HideWindow(WM_GetDialogItem(pMsg->hWin, ID_TEXT_2)); //Volts Rdbk
							WM_HideWindow(WM_GetDialogItem(pMsg->hWin, ID_TEXT_0)); //Amps Rdbk	
							//ID_DROPDOWN_PSUVW

							WM_HideWindow(WM_GetDialogItem(pMsg->hWin, ID_DROPDOWN_PSUVW)); //PSU/NODE VIEW
//							for(i=0;i<4;i++)
//							{
//								if(GuiState.SysDataPSU[i].fail_lockout > 0)
//								{
									WM_ShowWindow(WM_GetDialogItem(pMsg->hWin, ID_BUTTON_SCAN));
//								}
//							}							
						}
						else
						{
							WM_ShowWindow(WM_GetDialogItem(pMsg->hWin, ID_BUTTON_0));
							WM_ShowWindow(WM_GetDialogItem(pMsg->hWin, ID_BUTTON_1));
							WM_ShowWindow(WM_GetDialogItem(pMsg->hWin, ID_BUTTON_2));
							WM_ShowWindow(WM_GetDialogItem(pMsg->hWin, ID_BUTTON_5));
							WM_ShowWindow(WM_GetDialogItem(pMsg->hWin, ID_BUTTON_6));
							WM_ShowWindow(WM_GetDialogItem(pMsg->hWin, ID_BUTTON_3)); //DC ON/OFF
							WM_ShowWindow(WM_GetDialogItem(pMsg->hWin, ID_TEXT_2)); //Volts Rdbk
							WM_ShowWindow(WM_GetDialogItem(pMsg->hWin, ID_TEXT_0)); //Amps Rdbk	
							
							WM_ShowWindow(WM_GetDialogItem(pMsg->hWin, ID_DROPDOWN_PSUVW)); //PSU/NODE VIEW
							WM_HideWindow(WM_GetDialogItem(pMsg->hWin, ID_BUTTON_SCAN));
						}
						
//						if(GUI_Style == 0)
//						{
//							WM_HideWindow(WM_GetDialogItem(pMsg->hWin, ID_TXT_STA_EN));
//						}
//						else
//						{
//							WM_ShowWindow(WM_GetDialogItem(pMsg->hWin, ID_TXT_STA_EN));
//						}
						if(GuiState.demo)
						{
							GuiState.SysDataPSU[GuiState.psu_viewing].Vrdbk=GuiState.SysDataPSU[GuiState.psu_viewing].pflparams.rec_vset;
							GuiState.SysDataPSU[GuiState.psu_viewing].Irdbk=GuiState.SysDataPSU[GuiState.psu_viewing].pflparams.rec_iset;
						}
			
						if((lastdata.lastVrd[GuiState.psu_viewing] != GuiState.SysDataPSU[GuiState.psu_viewing].Vrdbk)||
							(GuiState.SysDataPSU[GuiState.psu_viewing].Vrdbk == 0.0))
						{	
								lastdata.lastVrd[GuiState.psu_viewing] = GuiState.SysDataPSU[GuiState.psu_viewing].Vrdbk;
								hItem = WM_GetDialogItem(pMsg->hWin, ID_TEXT_2);
								
								//if(GuiState.SysDataPSU[GuiState.psu_viewing].Vrdbk ==0){strncpy(dbgstr,"OFF",3);}
								//else{sprintf(dbgstr,"%2.1f",(float)GuiState.SysDataPSU[GuiState.psu_viewing].Vrdbk/10);}
								sprintf(dbgstr,"%2.1f",(float)GuiState.SysDataPSU[GuiState.psu_viewing].Vrdbk/10);
								TEXT_SetText(hItem, dbgstr);
								if(GuiState.SysDataPSU[GuiState.psu_viewing].Vrdbk <=200)
								{
										TEXT_SetTextColor(hItem, GUI_RED);
								}
								else
								{
										TEXT_SetTextColor(hItem, GUI_GRAY);
								}
						}
						
						if((lastdata.lastIrd[GuiState.psu_viewing] != GuiState.SysDataPSU[GuiState.psu_viewing].Irdbk)||
							(GuiState.SysDataPSU[GuiState.psu_viewing].Irdbk == 0.0))
						{	
								lastdata.lastIrd[GuiState.psu_viewing] = GuiState.SysDataPSU[GuiState.psu_viewing].Irdbk;
								hItem = WM_GetDialogItem(pMsg->hWin, ID_TEXT_0);
								
								//if(GuiState.SysDataPSU[GuiState.psu_viewing].Irdbk ==0){strncpy(dbgstr,"OFF",3);}
								//else{sprintf(dbgstr,"%3.0f",(float)GuiState.SysDataPSU[GuiState.psu_viewing].Irdbk/10);}
								//sprintf(dbgstr,"%3.0f",(float)GuiState.SysDataPSU[GuiState.psu_viewing].Irdbk/10);
							  sprintf(dbgstr,"%3.1f",(float)GuiState.SysDataPSU[GuiState.psu_viewing].Irdbk/10);
								TEXT_SetText(hItem, dbgstr);
								if(GuiState.SysDataPSU[GuiState.psu_viewing].Irdbk >=100)
								{
										TEXT_SetTextColor(hItem, GUI_RED);
								}
								else
								{
										TEXT_SetTextColor(hItem, GUI_GRAY);
								}
						}
						
						// Debug code to toggle comms flt led so i can see signs of life
//						if((GuiState.SysDataPSU[GuiState.psu_viewing].AlmReg >>7) & 0x0001)
//						{
//								GuiState.SysDataPSU[GuiState.psu_viewing].AlmReg &= 0xFF7F;    
//						}
//						else
//						{
//								GuiState.SysDataPSU[GuiState.psu_viewing].AlmReg |= 0x0080;
//						}
						
						// Check alarm reg state and set grn leds ON or OFF based on each bit state
						if(lastdata.last_almreg[GuiState.psu_viewing] != GuiState.SysDataPSU[GuiState.psu_viewing].AlmReg)
						//{	
									//lastdata.last_almreg[GuiState.psu_viewing] = GuiState.SysDataPSU[GuiState.psu_viewing].AlmReg;
									ChkLedImgs(hWin,GuiState.SysDataPSU[GuiState.psu_viewing].AlmReg);
						//}
						
						// Populate the Selected PSU in the dropdown box if they have been initialized via CAN
						// Cycle through all PSU data structs checking for a valid PSUADR ( not 0xff thats invalid)
						hItem = WM_GetDialogItem(pMsg->hWin, ID_DROPDOWN_PSUVW);
						//DROPDOWN_SetSel(hItem,GuiState.psu_viewing);//EAJ 2/26/2016 Remove for TEST
						DROPDOWN_SetSelExp(hItem,GuiState.psu_viewing);
						for(i=0;i<4;i++)
						{		
									if(lastdata.last_psuadr[i] != GuiState.SysDataPSU[i].PSU_ADDR)
									{
													lastdata.last_psuadr[i] = GuiState.SysDataPSU[i].PSU_ADDR;  //update last value
													// If this PSU contains an INVALID PSUADR (oxff) delete the line item
													// DO NOT delete the line if it is the NO PSU YET line
													//memset(chbuff,0,sizeof(chbuff));
													if(GuiState.SysDataPSU[i].PSU_ADDR == 0x00ff)
													{
																DROPDOWN_DeleteItem(hItem,i); // delete the line so we can add the new data in that line index
																DROPDOWN_InsertString(hItem,_acDpdn[i+4],i);// write the "PSU OFFx" where x = PSU that responded
																DROPDOWN_SetItemDisabled(hItem,i,1);
													}
													else
													{
																DROPDOWN_DeleteItem(hItem,i); // delete the line so we can add the new data in that line index
																DROPDOWN_InsertString(hItem,_acDpdn[i],i);// write the "PSU ADRx" where x = PSU that responded
																DROPDOWN_SetItemDisabled(hItem,i,0);
													}
													
													DROPDOWN_SetListHeight(hItem,DROPDOWN_GetNumItems(hItem)* 25);
										}
							}
//							// Set buuton focus to which ever button that matches the state we are in
//							if(GuiState.SysDataPSU[GuiState.psu_viewing].pflparams.psu_mode == P_CV)
//							{
//									hItem = WM_GetDialogItem(pMsg->hWin, ID_BUTTON_0);
//									BUTTON_SetPressed(hItem,1);
//									hItem = WM_GetDialogItem(pMsg->hWin, ID_BUTTON_1);
//									BUTTON_SetPressed(hItem,0);
//									hItem = WM_GetDialogItem(pMsg->hWin, ID_BUTTON_2);
//									BUTTON_SetPressed(hItem,0);
//							}
//							else if(GuiState.SysDataPSU[GuiState.psu_viewing].pflparams.psu_mode == P_CI)
//							{
//									hItem = WM_GetDialogItem(pMsg->hWin, ID_BUTTON_0);
//									BUTTON_SetPressed(hItem,0);
//									hItem = WM_GetDialogItem(pMsg->hWin, ID_BUTTON_1);
//									BUTTON_SetPressed(hItem,1);
//									hItem = WM_GetDialogItem(pMsg->hWin, ID_BUTTON_2);
//									BUTTON_SetPressed(hItem,0);
//							}
//							else if(GuiState.SysDataPSU[GuiState.psu_viewing].pflparams.psu_mode == P_CPOT)
//							{
//									hItem = WM_GetDialogItem(pMsg->hWin, ID_BUTTON_0);
//									BUTTON_SetPressed(hItem,0);
//									hItem = WM_GetDialogItem(pMsg->hWin, ID_BUTTON_1);
//									BUTTON_SetPressed(hItem,0);
//									hItem = WM_GetDialogItem(pMsg->hWin, ID_BUTTON_2);
//									BUTTON_SetPressed(hItem,1);
//							}
							pImgDataOff = _GetImageById(ID_IMAGE_OFF_GRAY_40x8, &FileSize); // grn_led_off
							pImgDataOn = _GetImageById(ID_IMAGE_ON_GRN_40x8, &FileSize); // grn_led_on
							
							if(GuiState.SysDataPSU[GuiState.psu_viewing].pflparams.psu_mode == P_OFF) //EAJ 2016/01/12
							{
								  //EAJ 2016/01/12 - Update DC On/Off Button text and LED
								  hItem = WM_GetDialogItem(hWin, ID_BUTTON_3);
									BUTTON_SetText(hItem, "DC ON");
									GuiState.SysDataPSU[GuiState.psu_viewing].Status &= 0xffdf; //and off REC SET on\off
									pData = _GetImageById(ID_IMAGE_0_IMAGE_2, &FileSize); // grn_led_off
								pImgData = _GetImageById(ID_IMAGE_OFF_GRAY_40x8, &FileSize); // grn_led_off
								
								TEXT_SetBkColor(WM_GetDialogItem(pMsg->hWin, ID_TXT_STA_EN), GUI_GRAY);
								BUTTON_SetBkColor(WM_GetDialogItem(hWin, ID_BUTTON_3), BUTTON_CI_UNPRESSED, GUI_GRAY);
								
								if(GuiState.style == 1)
								{
									BUTTON_SetBMPEx(WM_GetDialogItem(hWin, ID_BUTTON_0), BUTTON_BI_UNPRESSED, pImgData,(XDBTNM-40)/2, 2);
									BUTTON_SetBMPEx(WM_GetDialogItem(hWin, ID_BUTTON_1), BUTTON_BI_UNPRESSED, pImgData,(XDBTNM-40)/2, 2);
									BUTTON_SetBMPEx(WM_GetDialogItem(hWin, ID_BUTTON_2), BUTTON_BI_UNPRESSED, pImgData,(XDBTNM-40)/2, 2);
								}
							}
							else
							{
								BUTTON_SetBkColor(WM_GetDialogItem(hWin, ID_BUTTON_3), BUTTON_CI_UNPRESSED, GUI_GREEN);
								TEXT_SetBkColor(WM_GetDialogItem(pMsg->hWin, ID_TXT_STA_EN), GUI_GREEN);
								  //EAJ 2016/01/12 - Update DC On/Off Button text and LED
								  hItem = WM_GetDialogItem(hWin, ID_BUTTON_3);
									BUTTON_SetText(hItem, "DC OFF");
									GuiState.SysDataPSU[GuiState.psu_viewing].Status |= 0x0020; //OR on REC SET on\off
									pData = _GetImageById(ID_IMAGE_0_IMAGE_1, &FileSize); // grn_led_on
								pImgData = _GetImageById(ID_IMAGE_ON_GRN_40x8, &FileSize); // grn_led_on

									// Set buuton focus to which ever button that matches the state we are in
									if(GuiState.SysDataPSU[GuiState.psu_viewing].pflparams.psu_mode == P_CV)
									{
											hItem = WM_GetDialogItem(pMsg->hWin, ID_BUTTON_0);
											BUTTON_SetPressed(hItem,1);
											hItem = WM_GetDialogItem(pMsg->hWin, ID_BUTTON_1);
											BUTTON_SetPressed(hItem,0);
											hItem = WM_GetDialogItem(pMsg->hWin, ID_BUTTON_2);
											BUTTON_SetPressed(hItem,0);
										
											if(GuiState.style == 1)
											{
												BUTTON_SetBMPEx(WM_GetDialogItem(hWin, ID_BUTTON_0), BUTTON_BI_UNPRESSED, pImgDataOn,(XDBTNM-40)/2, 3);
												BUTTON_SetBMPEx(WM_GetDialogItem(hWin, ID_BUTTON_1), BUTTON_BI_UNPRESSED, pImgDataOff,(XDBTNM-40)/2, 3);
												BUTTON_SetBMPEx(WM_GetDialogItem(hWin, ID_BUTTON_2), BUTTON_BI_UNPRESSED, pImgDataOff,(XDBTNM-40)/2, 3);
											}
								}
									else if(GuiState.SysDataPSU[GuiState.psu_viewing].pflparams.psu_mode == P_CI)
									{
											hItem = WM_GetDialogItem(pMsg->hWin, ID_BUTTON_0);
											BUTTON_SetPressed(hItem,0);
											hItem = WM_GetDialogItem(pMsg->hWin, ID_BUTTON_1);
											BUTTON_SetPressed(hItem,1);
											hItem = WM_GetDialogItem(pMsg->hWin, ID_BUTTON_2);
											BUTTON_SetPressed(hItem,0);
										
											if(GuiState.style == 1)
											{
												BUTTON_SetBMPEx(WM_GetDialogItem(hWin, ID_BUTTON_0), BUTTON_BI_UNPRESSED, pImgDataOff,(XDBTNM-40)/2, 3);
												BUTTON_SetBMPEx(WM_GetDialogItem(hWin, ID_BUTTON_1), BUTTON_BI_UNPRESSED, pImgDataOn,(XDBTNM-40)/2, 3);
												BUTTON_SetBMPEx(WM_GetDialogItem(hWin, ID_BUTTON_2), BUTTON_BI_UNPRESSED, pImgDataOff,(XDBTNM-40)/2, 3);
											}
									}
									else if(GuiState.SysDataPSU[GuiState.psu_viewing].pflparams.psu_mode == P_CPOT)
									{
											hItem = WM_GetDialogItem(pMsg->hWin, ID_BUTTON_0);
											BUTTON_SetPressed(hItem,0);
											hItem = WM_GetDialogItem(pMsg->hWin, ID_BUTTON_1);
											BUTTON_SetPressed(hItem,0);
											hItem = WM_GetDialogItem(pMsg->hWin, ID_BUTTON_2);
											BUTTON_SetPressed(hItem,1);
										
											if(GuiState.style == 1)
											{
												BUTTON_SetBMPEx(WM_GetDialogItem(hWin, ID_BUTTON_0), BUTTON_BI_UNPRESSED, pImgDataOff,(XDBTNM-40)/2, 3);
												BUTTON_SetBMPEx(WM_GetDialogItem(hWin, ID_BUTTON_1), BUTTON_BI_UNPRESSED, pImgDataOff,(XDBTNM-40)/2, 3);
												BUTTON_SetBMPEx(WM_GetDialogItem(hWin, ID_BUTTON_2), BUTTON_BI_UNPRESSED, pImgDataOn,(XDBTNM-40)/2, 3);
											}
									}
							}

							// commit the IMG source change to each LED obj on this screen
							hItem = WM_GetDialogItem(hWin, ID_IMAGE_IO);// find the LED obj we want to change
							IMAGE_SetBMP(hItem, pData, FileSize);     // change the img source for the bmp img obj
							
							if(GuiState.style == 1)
							{
								BUTTON_SetBMPEx(WM_GetDialogItem(hWin, ID_BUTTON_3), BUTTON_BI_UNPRESSED, pImgData,(XDBTNM-40)/2, YDBTNM-11);
								MoveObjects(pMsg);
								DrawRects(pMsg);
							}
							else
							{
								MoveObjectsBack(pMsg);
							}
							
//							BUTTON_SetDefaultBkColor(BUTTON_CI_DISABLED, GUI_GREEN);
//							BUTTON_SetDefaultBkColor(BUTTON_CI_PRESSED, GUI_GREEN);
//							BUTTON_SetDefaultBkColor(BUTTON_CI_UNPRESSED, GUI_GREEN);
//							
//							BUTTON_SetBkColor(WM_GetDialogItem(hWin, ID_BUTTON_3), BUTTON_CI_DISABLED , GUI_GREEN);
//							BUTTON_SetBkColor(WM_GetDialogItem(hWin, ID_BUTTON_3), BUTTON_CI_PRESSED, GUI_GREEN);
//							BUTTON_SetBkColor(WM_GetDialogItem(hWin, ID_BUTTON_3), BUTTON_CI_UNPRESSED, GUI_GREEN);
							//DrawRects(pMsg);
							//WM_GetClientRectEx(WM_GetDialogItem(pMsg->hWin, ID_TEXT_0),&tmpRect);GUI_DrawRectEx(&tmpRect);
							//WM_GetClientRectEx(WM_GetDialogItem(pMsg->hWin, ID_TEXT_2),&tmpRect);GUI_DrawRectEx(&tmpRect);
			break;

			default:
						WM_DefaultProc(pMsg);
		
  }// END switch pMsg->MsgId
}// END function

WM_HWIN GetWinHandleIccpmain(void)
{
	return iccpmain_hdl;
}

/*********************************************************************
*
*       Public code
*
**********************************************************************
*/
/*********************************************************************
*
*       Createiccp_main
*/
static void Startup(WM_HWIN hWin, uint16_t xpos, uint16_t ypos)
{
		iccpmain_hdl = GUI_CreateDialogBox(_aDialogCreate, GUI_COUNTOF(_aDialogCreate), _cbDialog, hWin, xpos, ypos);
		GuiState.gui_scn_state = G_RTSTA;
		GuiState.ScreenTimeout = 0;	
}

						// Repaint LEDs
						// bit  0: output on\off 0=off
						// bit  1: DCOK 
						// bit  2: ACOK
						// bit  3: RECT SUM FLT
						// bit  4: Manual Mode 0= auto 1= manual
						// bit  5: output on\off 0=off
						// bit  6: ref_elec 0=passing 1=at least one refelec is failed
						// bit  7: communications fault CAN stopped for >2 sec
						// bit  8: surge protector flt detected
						// bit  9: Current Imbalance
						// bit 10: Door Status 0= closed 1=open
						// bit 11: Last Self Test 0=failed 1=passed
						//	{ IMAGE_CreateIndirect, "atdilogo_bmp", ID_IMAGE_0,      0,    0, 240, 50, 0, 0, 0 },
						//  { IMAGE_CreateIndirect, "acokled_bmp", ID_IMAGE_1,      26, YPLED,  20, 20, 0, 0, 0 },
						//  { IMAGE_CreateIndirect, "dcokled_bmp", ID_IMAGE_2,     106, YPLED,  20, 20, 0, 0, 0 },
						//  { IMAGE_CreateIndirect, "rectled_bmp", ID_IMAGE_3,     180, YPLED,  20, 20, 0, 0, 0 },
						//  { IMAGE_CreateIndirect, "surgeled_bmp", ID_IMAGE_4,    255, YPLED,  20, 20, 0, 0, 0 },
						//  { IMAGE_CreateIndirect, "refelectled_bmp", ID_IMAGE_5, 330, YPLED,  20, 20, 0, 0, 0 },
						//  { IMAGE_CreateIndirect, "commfltled_bmp", ID_IMAGE_6,  405, YPLED,  20, 20, 0, 0, 0 },

void ChkLedImgs(WM_HWIN hWin, uint16_t almreg)
{
	int8_t i,img_id;
	static char LED_COM_OK = 0;
	WM_HWIN hItem;
	const void * pData;
  U32          FileSize;
	uint16_t guiobj_id;
	uint16_t guiobj_text;
	uint8_t testbit, shiftqty;
	//#define GUI_EXTRALIGHTGRAY     0x00F0F0F0 //Was 0x00E0E0E0
	uint32_t FaultBkColor = 0;
	uint32_t FaultTextColor = 0;
	
//		{ TEXT_CreateIndirect, "AC"          , ID_TEXT_AC,             XDLGP-10, YPLED-30,  44, 32, 0, 0, 0 },
//  { TEXT_CreateIndirect, "DC"          , ID_TEXT_DC,  (XYDL*1+XDLGP*2)-10, YPLED-30,  44, 32, 0, 0, 0 },
//	{ TEXT_CreateIndirect, "REC"         , ID_TEXT_RCT,(XYDL*2+XDLGP*3)-10, YPLED-30,  44, 32, 0, 0, 0 },
//  { TEXT_CreateIndirect, "SURGE"       , ID_TEXT_SRG,(XYDL*3+XDLGP*4)-20, YPLED-30,  64, 32, 0, 0, 0 },
//  { TEXT_CreateIndirect, "REF"         , ID_TEXT_REF,(XYDL*4+XDLGP*5)-10, YPLED-30,  44, 32, 0, 0, 0 },
//  { TEXT_CreateIndirect, "COM"         , ID_TEXT_COM,(XYDL*5+XDLGP*6)-10, YPLED-30,  44, 32, 0, 0, 0 },
	
	// loop over all 6 leds on the main screen
	for(i=0;i<6;i++)
	{
			switch (i)
			{
				case 0:
					guiobj_id = ID_IMAGE_1; // ACOK LED
				  guiobj_text = ID_TEXT_AC;
					shiftqty = 2;
				break;
				
				case 1:
					guiobj_id = ID_IMAGE_2; // DCOK LED
					guiobj_text = ID_TEXT_DC;
					shiftqty = 1;
				break;
				
				case 2:
					guiobj_id = ID_IMAGE_3; // RECT SUM FLT LED
					guiobj_text = ID_TEXT_RCT;
					shiftqty = 3;
				break;

				case 3:
					guiobj_id = ID_IMAGE_4; // SURGE FLT LED
					guiobj_text = ID_TEXT_SRG;
					shiftqty = 8;
				break;
				
				case 4:
					guiobj_id = ID_IMAGE_5; // REF ELECTRODE FLT LED
					guiobj_text = ID_TEXT_REF;
					shiftqty = 6;
				break;
				
				case 5:
					guiobj_id = ID_IMAGE_6; // COM FLT FLT LED
					guiobj_text = ID_TEXT_COM;
					shiftqty = 7;
				break;
				
				default:
				break;
			}
			
			testbit = almreg>>shiftqty & 0x0001;
			// if bit from alarm reg we are testing this iteration is a 1 illuminate LED if Zero extinguish led
			// by changeing the bmp we assign to the LED locations on the screen
			// EAJ 2/10/2016 - Reverse LED indicator logic: 0 = illuminate LED
			if(!testbit)
			{	
				img_id = ID_IMAGE_0_IMAGE_1;// grn led ON
				//img_id = ID_IMAGE_ON_RED_20x20;// red led ON
				FaultBkColor = GUI_GREEN;
				FaultTextColor = GUI_BLACK;
				if((GuiState.SysDataPSU[GuiState.psu_viewing].psufail_cnt > 1)&&(guiobj_text == ID_TEXT_COM))
				{
					FaultBkColor = GUI_RED;
					FaultTextColor = GUI_WHITE;
				}
				
				if(guiobj_id == ID_IMAGE_6)//COM LED
				{
					if(LED_COM_OK)
					{
						LED_COM_OK=0;
						img_id = ID_IMAGE_0_IMAGE_2;// grn led OFF
						
					}
					else
					{
						LED_COM_OK=1;
						img_id = ID_IMAGE_0_IMAGE_1;// grn led ON
					}
				}
			}
			else
			{
				//img_id = ID_IMAGE_0_IMAGE_2;// grn led OFF
				img_id = ID_IMAGE_ON_RED_20x20;// red led ON
				FaultBkColor = GUI_GRAY;
				FaultTextColor = GUI_BLACK;
			}
			
			if(guiobj_id == ID_IMAGE_2){img_id = ID_IMAGE_0_IMAGE_2;}// grn led OFF}
			if(guiobj_id == ID_IMAGE_4){img_id = ID_IMAGE_0_IMAGE_2;}// grn led OFF}
				
			
			//ID_IMAGE_0_IMAGE_2
			//GuiState.SysDataPSU[psuidx].fail_lockout = 1;
			//GuiState.SysDataPSU[GuiState.psu_viewing].pflparams.psu_mode == P_CPOT
			if((GuiState.SysDataPSU[GuiState.psu_viewing].fail_lockout == 1)&&(guiobj_text == ID_TEXT_COM))
			{
				FaultBkColor = GUI_RED;
				FaultTextColor = GUI_WHITE;
			}
			
			// commit the IMG source change to each LED obj on this screen
			hItem = WM_GetDialogItem(hWin, guiobj_id);// find the LED obj we want to change
			pData = _GetImageById(img_id, &FileSize); // find the bmp img array we want
			IMAGE_SetBMP(hItem, pData, FileSize);     // change the img source for the bmp img obj
			
			if(GuiState.style == 1)
			{
					TEXT_SetBkColor(WM_GetDialogItem(hWin, guiobj_text),FaultBkColor);
					TEXT_SetTextColor(WM_GetDialogItem(hWin, guiobj_text),FaultTextColor);
			}
			else
			{
					TEXT_SetBkColor(WM_GetDialogItem(hWin, guiobj_text),GUI_WHITE);
					TEXT_SetTextColor(WM_GetDialogItem(hWin, guiobj_text),0x00FF0000);
			}
	}
}


/**
  * @brief  Text direct open
  * @param  filename: text file name
  * @retval None
  */
static void TextDirectOpen(char *filename)
{
//		WM_HWIN hItem;  
//		static char tmp[FILEMGR_FILE_NAME_SIZE];    
//		
//		FRESULT res;                                          /* FatFs function common result code */
//		uint32_t byteswritten, bytesread;                     /* File write/read counts */
//		uint8_t wtext[] = "ICCP wrote this line"; /* File write buffer */
//		uint8_t rtext[100];                                   /* File read buffer */
//		
//			
//		/*##-4- Open a text file object with write access #####*/
//		if(f_open(&MyFile, filename, FA_WRITE) != FR_OK)
//		{
//			/* 'STM32.TXT' file Open for write Error */
//			//Error_Handler();
//		}
//		else
//		{
//					/*##-8- Read data from the text file ###########################*/
//					res = f_read(&MyFile, rtext, sizeof(rtext), (UINT*)&bytesread);
//					
//					if((bytesread == 0) || (res != FR_OK))
//					{
//						/* 'STM32.TXT' file Read or EOF Error */
//						//Error_Handler();
//					}
//					else
//					{
//						/*##-9- Close the open text file #############################*/
//						f_close(&MyFile);
//						hItem = WM_GetDialogItem(iccpmain_hdl, ID_TEXT_0);
//						TEXT_SetText(hItem, (char *)rtext);
//						
//						
//					}
//		}
            
}

void DrawRects(WM_MESSAGE *pMsg)
{
//	int X=0;
//	int Y=0;
//	WM_HWIN hWin;
//	
//			hWin=WM_GetDialogItem(pMsg->hWin, ID_TEXT_0);
//			WM_GetClientRectEx(hWin,&tmpRect);
//			X=WM_GetWindowOrgX(hWin);
//			Y=WM_GetWindowOrgX(hWin);	
//			GUI_DrawRect(X--,Y--,tmpRect.x1++,tmpRect.y1++);

//			hWin=WM_GetDialogItem(pMsg->hWin, ID_TEXT_2);
//			WM_GetClientRectEx(hWin,&tmpRect);
//			X=WM_GetWindowOrgX(hWin);
//			Y=WM_GetWindowOrgX(hWin);	
//			GUI_DrawRect(X--,Y--,tmpRect.x1++,tmpRect.y1++);
	
//		{ TEXT_CreateIndirect, "AC"          , ID_TEXT_AC,             XDLGP-10, YPLED-30,  44, 32, 0, 0, 0 },
//  { TEXT_CreateIndirect, "DC"          , ID_TEXT_DC,  (XYDL*1+XDLGP*2)-10, YPLED-30,  44, 32, 0, 0, 0 },
//	{ TEXT_CreateIndirect, "REC"         , ID_TEXT_RCT,(XYDL*2+XDLGP*3)-10, YPLED-30,  44, 32, 0, 0, 0 },
//  { TEXT_CreateIndirect, "SURGE"       , ID_TEXT_SRG,(XYDL*3+XDLGP*4)-20, YPLED-30,  64, 32, 0, 0, 0 },
//  { TEXT_CreateIndirect, "REF"         , ID_TEXT_REF,(XYDL*4+XDLGP*5)-10, YPLED-30,  44, 32, 0, 0, 0 },
//  { TEXT_CreateIndirect, "COM"         , ID_TEXT_COM,(XYDL*5+XDLGP*6)-10, YPLED-30,  44, 32, 0, 0, 0 },
	
	DrawRect(WM_GetDialogItem(pMsg->hWin, ID_TEXT_3));
	DrawRect(WM_GetDialogItem(pMsg->hWin, ID_TEXT_1));
	
	DrawRect(WM_GetDialogItem(pMsg->hWin, ID_TEXT_0));
	DrawRect(WM_GetDialogItem(pMsg->hWin, ID_TEXT_2));
	
	DrawRect(WM_GetDialogItem(pMsg->hWin, ID_TEXT_AC));
	DrawRect(WM_GetDialogItem(pMsg->hWin, ID_TEXT_DC));
	DrawRect(WM_GetDialogItem(pMsg->hWin, ID_TEXT_RCT));
	DrawRect(WM_GetDialogItem(pMsg->hWin, ID_TEXT_SRG));
	DrawRect(WM_GetDialogItem(pMsg->hWin, ID_TEXT_REF));
	DrawRect(WM_GetDialogItem(pMsg->hWin, ID_TEXT_COM));
	
}

void DrawRect(WM_HWIN hWin)
{
	int X=0;
	int Y=0;

	GUI_SetColor(GUI_BLACK);
	GUI_SetPenSize(2);
	
	WM_GetWindowRectEx(hWin,&tmpRect);
	X=WM_GetWindowOrgX(WM_GetParent(hWin));
	Y=WM_GetWindowOrgY(WM_GetParent(hWin));	
	GUI_DrawRect(tmpRect.x0-X-1,tmpRect.y0-Y-1,tmpRect.x1-X+1,tmpRect.y1-Y+1);
}

void SaveXYs(WM_MESSAGE *pMsg)
{
	SaveXY(WM_GetDialogItem(pMsg->hWin, ID_TEXT_AC),0);
	SaveXY(WM_GetDialogItem(pMsg->hWin, ID_TEXT_DC),1);
	SaveXY(WM_GetDialogItem(pMsg->hWin, ID_TEXT_RCT),2);
	SaveXY(WM_GetDialogItem(pMsg->hWin, ID_TEXT_SRG),3);
	SaveXY(WM_GetDialogItem(pMsg->hWin, ID_TEXT_REF),4);
	SaveXY(WM_GetDialogItem(pMsg->hWin, ID_TEXT_COM),5);
	SaveXY(WM_GetDialogItem(pMsg->hWin, ID_TEXT_3),6);
	SaveXY(WM_GetDialogItem(pMsg->hWin, ID_TEXT_2),7);
	SaveXY(WM_GetDialogItem(pMsg->hWin, ID_TEXT_1),8);
	SaveXY(WM_GetDialogItem(pMsg->hWin, ID_TEXT_0),9);
	
//	  { TEXT_CreateIndirect, "VOLTS",     ID_TEXT_3,          10, 57,  68, 40, 0, 0, 0 },   //Vrdb label
//  { TEXT_CreateIndirect, "Volts_txt", ID_TEXT_2,          78, 57, 125, 40, 0, 0, 0 },   //VRDB
//  
//  { TEXT_CreateIndirect, "AMPS", 	  ID_TEXT_1,          215, 57,  68, 40, 0, 0x0, 0 },// Irdb label
//  { TEXT_CreateIndirect, "Amps_txt",  ID_TEXT_0,          283, 57, 125, 40, 0, 0x0, 0 },  //IRDB
}

void SaveXY(WM_HWIN hWin, int Index)
{
//	int X=0;
//	int Y=0;

//	GUI_SetColor(GUI_BLACK);
//	GUI_SetPenSize(2);
//	
//	WM_GetWindowRectEx(hWin,&tmpRect);
//	X=WM_GetWindowOrgX(WM_GetParent(hWin));
//	Y=WM_GetWindowOrgY(WM_GetParent(hWin));

//  XY[Index][0] = X;
//	XY[Index][1] = Y;
//	XY[Index][2] = tmpRect.x1;
//	XY[Index][3] = tmpRect.y1;
	
  XY[Index][0] = WM_GetWindowOrgX(hWin);
	XY[Index][1] = WM_GetWindowOrgY(hWin);
	XY[Index][2] = WM_GetWindowSizeX(hWin);
	XY[Index][3] = WM_GetWindowSizeY(hWin);
	//GUI_DrawRect(tmpRect.x0-X-1,tmpRect.y0-Y-1,tmpRect.x1-X+1,tmpRect.y1-Y+1);
}

void MoveObjects(WM_MESSAGE *pMsg)
{
	int i = 0;
	WM_HWIN hItem;
	int X = XSCN-(XDBTNM+20);
	int Y = 5+YDBTNM+5+YDBTNM+4;
	int W = XDBTNM;
	int H = 16;   //XY[0][3]
	
	if(MovedObjects == 1)
	{
		return;
	}
	//XSCN-(XDBTNM+20),        5,  XDBTNM, YDBTNM,
	WM_SetWindowPos(WM_GetDialogItem(pMsg->hWin, ID_TEXT_AC),X,Y+((H+5)*0),W,H);
	WM_SetWindowPos(WM_GetDialogItem(pMsg->hWin, ID_TEXT_DC),X,Y+((H+5)*1),W,H);
	WM_SetWindowPos(WM_GetDialogItem(pMsg->hWin, ID_TEXT_RCT),X,Y+((H+5)*2),W,H);
	WM_SetWindowPos(WM_GetDialogItem(pMsg->hWin, ID_TEXT_SRG),X,Y+((H+5)*3),W,H);
	WM_SetWindowPos(WM_GetDialogItem(pMsg->hWin, ID_TEXT_REF),X,Y+((H+5)*4),W,H);
	WM_SetWindowPos(WM_GetDialogItem(pMsg->hWin, ID_TEXT_COM),X,Y+((H+5)*5),W,H);
	
	WM_SetWindowPos(WM_GetDialogItem(pMsg->hWin, ID_TEXT_2),XY[7][0],		XY[7][1]+37,XY[7][2],XY[7][3]+5);
	WM_SetWindowPos(WM_GetDialogItem(pMsg->hWin, ID_TEXT_3),XY[7][0],		XY[7][1]+37-25-1,XY[7][2],25);
	
	WM_SetWindowPos(WM_GetDialogItem(pMsg->hWin, ID_TEXT_0),XY[9][0]-60,XY[9][1]+37,XY[9][2],XY[9][3]+5);
	WM_SetWindowPos(WM_GetDialogItem(pMsg->hWin, ID_TEXT_1),XY[9][0]-60,XY[9][1]+37-25-1,XY[9][2],25);
	
	//GUI_EXTRALIGHTGRAY 
	TEXT_SetBkColor(WM_GetDialogItem(pMsg->hWin, ID_TEXT_3),GUI_EXTRALIGHTGRAY);
	TEXT_SetBkColor(WM_GetDialogItem(pMsg->hWin, ID_TEXT_1),GUI_EXTRALIGHTGRAY);
	TEXT_SetTextColor(WM_GetDialogItem(pMsg->hWin, ID_TEXT_3),GUI_BLACK);
	TEXT_SetTextColor(WM_GetDialogItem(pMsg->hWin, ID_TEXT_1),GUI_BLACK);
	
	
	
	
	WM_HideWindow(WM_GetDialogItem(pMsg->hWin, ID_IMAGE_IO));
	WM_HideWindow(WM_GetDialogItem(pMsg->hWin, ID_IMAGE_1));
	WM_HideWindow(WM_GetDialogItem(pMsg->hWin, ID_IMAGE_2));
	WM_HideWindow(WM_GetDialogItem(pMsg->hWin, ID_IMAGE_3));
	WM_HideWindow(WM_GetDialogItem(pMsg->hWin, ID_IMAGE_4));
	WM_HideWindow(WM_GetDialogItem(pMsg->hWin, ID_IMAGE_5));
	WM_HideWindow(WM_GetDialogItem(pMsg->hWin, ID_IMAGE_6));
	
						/*******************			START CFG FLT LEDS			****************************/
						for(i=0;i<6;i++)
						{
								switch (i)
								{
											case 0:
														hItem = WM_GetDialogItem(pMsg->hWin, ID_TEXT_AC);
											break;
											
											case 1:
														hItem = WM_GetDialogItem(pMsg->hWin, ID_TEXT_DC);
											break;
											
											case 2:
														hItem = WM_GetDialogItem(pMsg->hWin, ID_TEXT_RCT);
											break;
											
											case 3:
														hItem = WM_GetDialogItem(pMsg->hWin, ID_TEXT_REF);
											break;
											
											case 4:
														hItem = WM_GetDialogItem(pMsg->hWin, ID_TEXT_SRG);
											break;
											
											case 5:
														hItem = WM_GetDialogItem(pMsg->hWin, ID_TEXT_COM);
											break;
											
											
								}
								TEXT_SetTextAlign(hItem, GUI_TA_HCENTER | GUI_TA_VCENTER);
								TEXT_SetFont(hItem, GUI_FONT_16B_1);
								//TEXT_SetTextColor(hItem, 0x00FF0000);
						}
		
						MovedObjects = 1;
}

void MoveObjectsBack(WM_MESSAGE *pMsg)
{
	int i = 0;
	WM_HWIN hItem;
	
	if(MovedObjects == 0)
	{
		return;
	}
	
		WM_SetWindowPos(WM_GetDialogItem(pMsg->hWin, ID_TEXT_AC),XY[i][0],XY[i][1],XY[i][2],XY[i][3]);i++;
		WM_SetWindowPos(WM_GetDialogItem(pMsg->hWin, ID_TEXT_DC),XY[i][0],XY[i][1],XY[i][2],XY[i][3]);i++;
		WM_SetWindowPos(WM_GetDialogItem(pMsg->hWin, ID_TEXT_RCT),XY[i][0],XY[i][1],XY[i][2],XY[i][3]);i++;
		WM_SetWindowPos(WM_GetDialogItem(pMsg->hWin, ID_TEXT_SRG),XY[i][0],XY[i][1],XY[i][2],XY[i][3]);i++;
		WM_SetWindowPos(WM_GetDialogItem(pMsg->hWin, ID_TEXT_REF),XY[i][0],XY[i][1],XY[i][2],XY[i][3]);i++;
		WM_SetWindowPos(WM_GetDialogItem(pMsg->hWin, ID_TEXT_COM),XY[i][0],XY[i][1],XY[i][2],XY[i][3]);i++;
	WM_SetWindowPos(WM_GetDialogItem(pMsg->hWin, ID_TEXT_3),XY[i][0],XY[i][1],XY[i][2],XY[i][3]);i++;
	WM_SetWindowPos(WM_GetDialogItem(pMsg->hWin, ID_TEXT_2),XY[i][0],XY[i][1],XY[i][2],XY[i][3]);i++;
	WM_SetWindowPos(WM_GetDialogItem(pMsg->hWin, ID_TEXT_1),XY[i][0],XY[i][1],XY[i][2],XY[i][3]);i++;
	WM_SetWindowPos(WM_GetDialogItem(pMsg->hWin, ID_TEXT_0),XY[i][0],XY[i][1],XY[i][2],XY[i][3]);i++;
	
		WM_ShowWindow(WM_GetDialogItem(pMsg->hWin, ID_IMAGE_IO));
	WM_ShowWindow(WM_GetDialogItem(pMsg->hWin, ID_IMAGE_1));
	WM_ShowWindow(WM_GetDialogItem(pMsg->hWin, ID_IMAGE_2));
	WM_ShowWindow(WM_GetDialogItem(pMsg->hWin, ID_IMAGE_3));
	WM_ShowWindow(WM_GetDialogItem(pMsg->hWin, ID_IMAGE_4));
	WM_ShowWindow(WM_GetDialogItem(pMsg->hWin, ID_IMAGE_5));
	WM_ShowWindow(WM_GetDialogItem(pMsg->hWin, ID_IMAGE_6));
	
	TEXT_SetBkColor(WM_GetDialogItem(pMsg->hWin, ID_TEXT_3),GUI_WHITE);
	TEXT_SetBkColor(WM_GetDialogItem(pMsg->hWin, ID_TEXT_1),GUI_WHITE);
	TEXT_SetTextColor(WM_GetDialogItem(pMsg->hWin, ID_TEXT_3),0x00FF0000);
	TEXT_SetTextColor(WM_GetDialogItem(pMsg->hWin, ID_TEXT_1),0x00FF0000);
	
	BUTTON_SetBMPEx(WM_GetDialogItem(hWin, ID_BUTTON_3), BUTTON_BI_UNPRESSED, NULL,(XDBTNM-40)/2, 3); //DC ON/OFF
	BUTTON_SetBMPEx(WM_GetDialogItem(hWin, ID_BUTTON_0), BUTTON_BI_UNPRESSED, NULL,(XDBTNM-40)/2, 3); //CV
	BUTTON_SetBMPEx(WM_GetDialogItem(hWin, ID_BUTTON_1), BUTTON_BI_UNPRESSED, NULL,(XDBTNM-40)/2, 3); //CI
	BUTTON_SetBMPEx(WM_GetDialogItem(hWin, ID_BUTTON_2), BUTTON_BI_UNPRESSED, NULL,(XDBTNM-40)/2, 3); //CP
	
						/*******************			START CFG FLT LEDS			****************************/
						for(i=0;i<6;i++)
						{
								switch (i)
								{
											case 0:
														hItem = WM_GetDialogItem(pMsg->hWin, ID_TEXT_AC);
											break;
											
											case 1:
														hItem = WM_GetDialogItem(pMsg->hWin, ID_TEXT_DC);
											break;
											
											case 2:
														hItem = WM_GetDialogItem(pMsg->hWin, ID_TEXT_RCT);
											break;
											
											case 3:
														hItem = WM_GetDialogItem(pMsg->hWin, ID_TEXT_REF);
											break;
											
											case 4:
														hItem = WM_GetDialogItem(pMsg->hWin, ID_TEXT_SRG);
											break;
											
											case 5:
														hItem = WM_GetDialogItem(pMsg->hWin, ID_TEXT_COM);
											break;
											
											
								}
								TEXT_SetTextAlign(hItem, GUI_TA_HCENTER | GUI_TA_VCENTER);
								TEXT_SetFont(hItem, GUI_FONT_20_1);
								TEXT_SetTextColor(hItem, 0x00FF0000);
						}
						
			MovedObjects = 0;
}


/********* END ICCP MAIN SCREEN   ********/

///************************ (C) COPYRIGHT AstrodyneTDI 2015 *****END OF FILE****/
